&i2c2 {
    pinctrl-0 = "&i2c2_pins";
    i2c_lcd: i2c_lcd@27 {
        compatible = "org,i2c-lcd";
        label = "i2c-lcd";
        reg = <0x27>;
    };
};

&am33xx_pinmux {
    i2c2_pins: pinmux_i2c2_pins {
        pinctrl-single,pins = <
            AM33XX_PADCONF(AM335X_PIN_UART1_CTSN, PIN_INPUT_PULLUP, MUX_MODE3)
            AM33XX_PADCONF(AM335X_PIN_UART1_RTSN, PIN_INPUT_PULLUP, MUX_MODE3)
        >;
    };
};